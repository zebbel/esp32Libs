## components/CRSF/Kconfig.projbuild
```kconfig
menu "espNow Configuration"
    config DEVICE_NAME
        string "device name in ESPNOW network"
        default "device"

    choice ESPNOW_WIFI_MODE
        prompt "WiFi mode"
        default ESPNOW_WIFI_MODE_STATION
        help
            WiFi mode(station or softap).

        config ESPNOW_WIFI_MODE_STATION
            bool "Station"
        config ESPNOW_WIFI_MODE_STATION_SOFTAP
            bool "Softap"
    endchoice

    config ESPNOW_PMK
        string "ESPNOW primary master key"
        default "zebbel$64646$PMK"
        help
            ESPNOW primary master key. The length of ESPNOW primary master must be 16 bytes.

    config ESPNOW_LMK
        string "ESPNOW local master key"
        default "zebbel$64646$LMK"
        help
            ESPNOW local master key. The length of ESPNOW local master must be 16 bytes.

    config ESPNOW_CHANNEL
        int "Channel"
        default 1
        range 0 14
        help
            The channel on which sending and receiving ESPNOW data.

    config ESPNOW_ENABLE_LONG_RANGE
        bool "Enable Long Range"
        default "n"
        help
            When enable long range, the PHY rate of ESP32 will be 512Kbps or 256Kbps

endmenu

menu "UART0 Configuration"

    config UART0_TX
        int "uart0 tx pin"
        default 43
        help
            GPIO number for UART0 tx.

    config UART0_RX
        int "uart0 rx pin"
        default 44
        help
            GPIO number for UART0 rx.

endmenu

menu "UART1 Configuration"

    config UART1_TX
        int "uart1 tx pin"
        default 13
        help
            GPIO number for UART1 tx.

    config UART1_RX
        int "uart1 rx pin"
        default 12
        help
            GPIO number for UART1 rx.

endmenu

menu "UART2 Configuration"

    config UART2_TX
        int "uart2tx pin"
        default 11
        help
            GPIO number for UART2 tx.

    config UART2_RX
        int "uart2 rx pin"
        default 10
        help
            GPIO number for UART2 rx.

endmenu
```

## components/FTP/Kconfig.projbuild
```kconfig
menu "FTP Server Configuration"
	menu "WiFi Setting"

		config ESP_WIFI_ST_SSID
			string "WiFi SSID"
			default "myssid"
			help
				SSID (network name) to connect to.

		config ESP_WIFI_ST_PASSWORD
			string "WiFi Password"
			default "mypassword"
			help
				WiFi password (WPA or WPA2) to connect to.

		config ESP_MAXIMUM_RETRY
			int "Maximum retry"
			default 5
			help
				Set the Maximum retry to avoid station reconnecting to the AP unlimited when the AP is really inexistent.

		config MDNS_HOSTNAME
			string "mDNS Hostname"
			default "ftp-server"
			help
				mDNS Hostname for FTP Server.

		config STATIC_IP
			bool "Enable Static IP Address"
			default false
			help
				Enable Static IP Address.

		config STATIC_IP_ADDRESS
			depends on STATIC_IP
			string "Static IP Address"
			default "192.168.10.100"
			help
				Static IP Address for Station.

		config STATIC_GW_ADDRESS
			depends on STATIC_IP
			string "Static GW Address"
			default "192.168.10.1"
			help
				Static GW Address for Station.

		config STATIC_NM_ADDRESS
			depends on STATIC_IP
			string "Static Netmask"
			default "255.255.255.0"
			help
				Static Netmask for Statione.
	endmenu

	menu "FTP Server Setting"
		config FTP_ANONYMOUS
			bool "Anonymous"
			default true
			help
				Use anonymous mode.

		config FTP_USER
			depends on !FTP_LOGIN
			string "FTP User Name"
			default "esp32"
			help
				FTP User name for this Server.

		config FTP_PASSWORD
			depends on !FTP_LOGIN
			string "FTP Password"
			default "esp32"
			help
				FTP Password for this Server.

	endmenu

endmenu
```

## components/button/Kconfig.projbuild
```kconfig
menu "Button Configuration"

    config BUTTON_PIN
        int "GPIO Num"
        default 0
        help
            GPIO number for Button

endmenu
```

## components/zBus/Kconfig.projbuild
```kconfig
menu "zBus_espNow Configuration"
    config DEVICE_NAME
        string "device name in ESPNOW network"
        default "device"

    choice ESPNOW_WIFI_MODE
        prompt "WiFi mode"
        default ESPNOW_WIFI_MODE_STATION
        help
            WiFi mode(station or softap).

        config ESPNOW_WIFI_MODE_STATION
            bool "Station"
        config ESPNOW_WIFI_MODE_STATION_SOFTAP
            bool "Softap"
    endchoice

    config ESPNOW_PMK
        string "ESPNOW primary master key"
        default "zebbel$64646$PMK"
        help
            ESPNOW primary master key. The length of ESPNOW primary master must be 16 bytes.

    config ESPNOW_LMK
        string "ESPNOW local master key"
        default "zebbel$64646$LMK"
        help
            ESPNOW local master key. The length of ESPNOW local master must be 16 bytes.

    config ESPNOW_CHANNEL
        int "Channel"
        default 1
        range 0 14
        help
            The channel on which sending and receiving ESPNOW data.

    config ESPNOW_ENABLE_LONG_RANGE
        bool "Enable Long Range"
        default "n"
        help
            When enable long range, the PHY rate of ESP32 will be 512Kbps or 256Kbps

endmenu

menu "zBus_uart Configuration"

    choice ZBUS_UART_NUM
        prompt "UART number"
        default UART_NUM_1

        config UART_NUM_0
            bool "UART 0"
        config UART_NUM_1
            bool "UART 1"
        config UART_NUM_2
            bool "UART 2"
    endchoice

    config UART_TX
        int "uart tx pin"
        default 13
        help
            GPIO number for UART tx.

    config UART_RX
        int "uart rx pin"
        default 12
        help
            GPIO number for UART rx.

endmenu
```

## managed_components/LSM9DS1/Kconfig.projbuild
```kconfig
menu "IMU Configuration"
    config I2C_MASTER_SCL
        int "SCL GPIO Num"
        default 19 if IDF_TARGET_ESP32 || IDF_TARGET_ESP32S2 || IDF_TARGET_ESP32S3
        default 2
        help
            GPIO number for I2C Master clock line.

    config I2C_MASTER_SDA
        int "SDA GPIO Num"
        default 18 if IDF_TARGET_ESP32 || IDF_TARGET_ESP32S2 || IDF_TARGET_ESP32S3
        default 1
        help
            GPIO number for I2C Master data line.

endmenu
```
